## code/main/Kconfig
```kconfig
menu "Transit Tracker Configuration"

    config WIFI_STA_CONNECT
        bool "Connect using WiFi"
        default n
        help
            Enables the WiFi driver to connect to your local network

    config TRACKER_BUSES_ENABLED
        bool "Enable bus tracking"
        default y
        help
            Enables the transit tracker application to track buses

    config TRACKER_TRAINS_ENABLED
        bool "Enable train tracking"
        default y
        help
            Enables the transit tracker application to track trains

    config TRACKER_TIME_ENABLED
        bool "Enable time display"
        default y
        help
            Enables the train tracker application to display time

    if TRACKER_BUSES_ENABLED
        config TRACKER_BUS_ROUTES
            string "Bus routes to track"
            default "1,7,28"
            help
                Enter the bus routes you want to track separated with commas and no
                spaces. Like this: "route1,route2,route3..." You can add up to ten.

        config TRACKER_BUS_STPIDS
            string "Bus stop IDs to track"
            default "1583,4884,74,1875"
            help
                Enter the bus stop IDs you want to track, separated with commas and no
                spaces. Like this: "stpid1,stpid2,stpid3..."

        config TRACKER_BUS_TOP
            int "Max number of bus predictions to receive"
            default 6
            help
                Enter the maximum number of bus predictions the transit app should receive
                from the CTA servers. Enter no whitespace or other characters.
    endif
    
    if TRACKER_TRAINS_ENABLED
        config TRACKER_TRAIN_MAPID
            string "Train station IDs to track"
            default "41490"
            help
                Enter the train station IDs you want to track, separated with commans and 
                no spaces. LIke this: "station1,station2,station3,..."
        
        config TRACKER_TRAIN_MAX
            int "Max number of train predictions to receive"
            default 5
            help
                Enter the maximum number of train predictions the transit app should receive
                from the CTA servers. Enter no whitespace or other characters.
    endif

endmenu
```
